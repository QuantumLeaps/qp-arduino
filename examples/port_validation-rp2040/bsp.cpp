// Board Support Package for the RP2040 port-validation example: fixture safe
// state, the two analyzer probes, the tick, the QS transport and the QS
// commands. Handwritten for qp-arduino (QP/C++ v7.3.4). Not generated by QM.
#include "qpcpp.hpp"
#include "validation.hpp"
#include "bsp.hpp"

#include <pico/time.h>          // time_us_64(), from_us_since_boot()
#include <hardware/timer.h>     // hardware_alarm_*()
#include <hardware/watchdog.h>

using namespace QP;

Q_DEFINE_THIS_FILE

#ifndef QP_ARDUINO_QS_SERIAL
#define QP_ARDUINO_QS_SERIAL Serial
#endif
#ifndef QP_ARDUINO_QS_HOST_WAIT_MS
#define QP_ARDUINO_QS_HOST_WAIT_MS 5000U
#endif
#ifndef QP_ARDUINO_QS_SERVICE_US
#define QP_ARDUINO_QS_SERVICE_US 1000U
#endif
#ifndef QP_ARDUINO_QS_SERVICE_BYTES
#define QP_ARDUINO_QS_SERVICE_BYTES 64U
#endif

namespace {

enum BspRecords { // BSP-level QS user records
    TICK_LOST = QP::QS_USER + 9
};

QP::QSpyId const l_timerId = { 0U };
QP::QSpyId const l_commandId = { 0U };

//----------------------------------------------------------------------------
// Pins
#if defined(QP_ARDUINO_FIXTURE_MOUSE_JOYSTICK_PCB) && (QP_ARDUINO_FIXTURE_MOUSE_JOYSTICK_PCB != 0)
constexpr std::uint8_t kRolePin         = 25U; // FW_TRIG0 -> J1501 pin 26 -> TRIG0 -> LA5032 ch 16
constexpr std::uint8_t kTickProbePin    = 21U; // FW_TRIG1 -> J1501 pin 28 -> TRIG1 -> LA5032 ch 17
constexpr std::uint8_t kInstrBufOeNPin  = 24U;
constexpr std::uint8_t kBusSwEnNPin     = 9U;
constexpr std::uint8_t kHvEnPin         = 19U;
constexpr std::uint8_t kHvDiagEnPin     = 14U;
constexpr std::uint8_t kTmcCsNPin       = 2U;
constexpr std::uint8_t kTmcDrvEnNPin    = 3U;
#define BSP_HAS_TICK_PROBE 1

void driveOutput(std::uint8_t pin, PinStatus level) {
    digitalWrite(pin, level);
    pinMode(pin, OUTPUT);
}
void fixtureSafeState() { // mirrored from the joystick firmware's SafeState
    driveOutput(kBusSwEnNPin, HIGH);
    driveOutput(kHvEnPin, LOW);
    driveOutput(kHvDiagEnPin, LOW);
    driveOutput(kInstrBufOeNPin, HIGH);
    driveOutput(kTmcCsNPin, HIGH);
    driveOutput(kTmcDrvEnNPin, HIGH);
    driveOutput(kRolePin, LOW);
    driveOutput(kTickProbePin, LOW);
}
void fixtureEnableInstrumentPort() {
    digitalWrite(kInstrBufOeNPin, LOW);
}
#else
constexpr std::uint8_t kRolePin = LED_BUILTIN;
#ifdef QP_ARDUINO_TICK_PROBE_PIN
constexpr std::uint8_t kTickProbePin = QP_ARDUINO_TICK_PROBE_PIN;
#define BSP_HAS_TICK_PROBE 1
#else
#define BSP_HAS_TICK_PROBE 0
#endif
#endif

#if BSP_HAS_TICK_PROBE
inline void tickProbe(PinStatus level) { digitalWrite(kTickProbePin, level); }
#else
inline void tickProbe(PinStatus) {}
#endif

// Role marker on GP25 -------------------------------------------------------
volatile std::uint8_t l_role = BSP::ROLE_DISPATCH;

//----------------------------------------------------------------------------
// System clock tick: a hardware timer alarm owned by this BSP.
//
// Earlier revisions used the pico-sdk repeating timer, which lives in the
// default alarm pool shared with the core's USB task and delay(). On
// 2026-09-30 that tick silently stopped after a few minutes of trace-host
// attach/detach cycling while QS-RX, QS-TX and the QV loop kept running: an
// alarm pool re-add can fail and the repeating timer then simply ends. A
// claimed hardware alarm re-armed from its own interrupt has no shared
// bookkeeping. The idle loop also watches the tick and re-arms it, reporting
// the event as a TICK_LOST record, so a stopped tick can never be silent.
constexpr std::uint32_t kTickPeriodUs = 1000000U / BSP::TICKS_PER_SEC;
int l_tickAlarm = -1;                        // hardware alarm number, claimed at start-up
std::uint64_t l_tickTarget = 0U;             // absolute time (us) of the next tick
std::uint32_t volatile l_tickCount = 0U;     // ticks delivered
std::uint32_t volatile l_tickCatchUps = 0U;  // targets already in the past when re-armed
std::uint32_t volatile l_tickRearms = 0U;    // watchdog re-arms from the idle loop
std::uint32_t volatile l_lastTick_us = 0U;   // micros() at the last tick

void armTick() { // program the alarm for l_tickTarget, catching up if it already passed
    while (hardware_alarm_set_target(static_cast<uint>(l_tickAlarm),
                                     from_us_since_boot(l_tickTarget)))
    {
        l_tickTarget += kTickPeriodUs; // missed: move on without stopping
        ++l_tickCatchUps;
    }
}
void tickAlarmCallback(uint) {
    tickProbe(HIGH);
    l_tickTarget += kTickPeriodUs;
    armTick(); // re-arm first so a slow tick never loses the next one
    ++l_tickCount;
    l_lastTick_us = micros();
    QTimeEvt::tick(0U, &l_timerId); // process time events for tick rate 0
    tickProbe(LOW);
}
void startTick() {
    l_tickAlarm = hardware_alarm_claim_unused(true); // panics if none is free
    hardware_alarm_set_callback(static_cast<uint>(l_tickAlarm), &tickAlarmCallback);
    l_tickTarget = time_us_64() + kTickPeriodUs;
    l_lastTick_us = micros();
    armTick();
}
void tickWatchdog() { // idle loop: if the alarm ever stops, report it and re-arm
    // Read the tick's timestamp BEFORE the clock: the tick interrupt can land
    // between the two reads, and reading the clock first would then see a
    // "last tick" from the future and wrap to a huge elapsed time. That race
    // produced 20,098 spurious re-arms in the first hour-long run.
    std::uint32_t const last = l_lastTick_us;
    std::int32_t const elapsed = static_cast<std::int32_t>(micros() - last);
    if (elapsed > static_cast<std::int32_t>(5U * kTickPeriodUs)) {
        ++l_tickRearms;
        QS_BEGIN_ID(TICK_LOST, 0U)
            QS_U32(0U, l_tickCount);
            QS_U32(0U, l_tickRearms);
            QS_U32(0U, l_tickCatchUps);
        QS_END()
        l_tickTarget = time_us_64() + kTickPeriodUs;
        l_lastTick_us = micros();
        armTick();
    }
}

//----------------------------------------------------------------------------
// QS transport (see blinky_bsp-rp2040/bsp.cpp for the rationale)
// True when the transport should be touched on this idle pass. Every call
// into the USB CDC port runs TinyUSB's task, which inflated the tick and
// dispatch timings when the transport was serviced on every pass.
bool qsServiceDue() {
    static std::uint32_t last_us = 0U;
    std::uint32_t const now = micros();
    std::uint32_t const pending = QP::QS::priv_.used; // volatile, read once
    if ((pending < QP_ARDUINO_QS_SERVICE_BYTES) && ((now - last_us) < QP_ARDUINO_QS_SERVICE_US)) {
        return false;
    }
    last_us = now;
    return true;
}

void qsTransmitSome() {
    int const room = QP_ARDUINO_QS_SERIAL.availableForWrite();
    if (room > 0) {
        std::uint16_t len = (room > 0xFFFF) ? 0xFFFFU : static_cast<std::uint16_t>(room);
        std::uint8_t const * const buf = QS::getBlock(&len);
        if (buf != nullptr) {
            static_cast<void>(QP_ARDUINO_QS_SERIAL.write(buf, len));
        }
    }
}
void qsFlushBounded(std::uint32_t timeout_us) {
    std::uint32_t start = micros();
    for (;;) {
        int const room = QP_ARDUINO_QS_SERIAL.availableForWrite();
        if (room > 0) {
            std::uint16_t len = (room > 0xFFFF) ? 0xFFFFU : static_cast<std::uint16_t>(room);
            std::uint8_t const * const buf = QS::getBlock(&len);
            if (buf == nullptr) {
                return;
            }
            static_cast<void>(QP_ARDUINO_QS_SERIAL.write(buf, len));
            start = micros();
        }
        else if ((micros() - start) > timeout_us) {
            return;
        }
    }
}

} // unnamed namespace

//============================================================================
// BSP functions
void BSP::init() {
#if defined(QP_ARDUINO_FIXTURE_MOUSE_JOYSTICK_PCB) && (QP_ARDUINO_FIXTURE_MOUSE_JOYSTICK_PCB != 0)
    fixtureSafeState();
    fixtureEnableInstrumentPort();
#else
    pinMode(kRolePin, OUTPUT);
    digitalWrite(kRolePin, LOW);
#if BSP_HAS_TICK_PROBE
    pinMode(kTickProbePin, OUTPUT);
    digitalWrite(kTickProbePin, LOW);
#endif
#endif
    { // give a trace host the chance to attach before the dictionaries go out
        std::uint32_t const start = millis();
        while (!QP_ARDUINO_QS_SERIAL
               && ((millis() - start) < QP_ARDUINO_QS_HOST_WAIT_MS))
        {
            delay(10);
        }
    }
    QS_INIT(nullptr);
    QS_OBJ_DICTIONARY(&l_timerId);
    QS_OBJ_DICTIONARY(&l_commandId);
    QS_USR_DICTIONARY(TICK_LOST);
}
void BSP::setRole(std::uint8_t role) {
    l_role = static_cast<std::uint8_t>(role & 0x03U);
    digitalWrite(kRolePin, LOW);
    QS_BEGIN_ID(PROBE_ROLE, 0U)
        QS_U8(0U, l_role);
    QS_END()
}
void BSP::roleHigh(std::uint8_t role) {
    if (l_role == role) {
        digitalWrite(kRolePin, HIGH);
    }
}
void BSP::roleLow(std::uint8_t role) {
    if (l_role == role) {
        digitalWrite(kRolePin, LOW);
    }
}
void BSP::rolePulse(std::uint8_t role) {
    roleHigh(role);
    roleLow(role);
}

//============================================================================
// QF callbacks
void QF::onStartup() {
    startTick(); // interrupts start here, after the AOs are started
}
void QF::onCleanup() {
}
void QV::onIdle() { // called with interrupts DISABLED
    BSP::roleHigh(BSP::ROLE_IDLE);
    QF_INT_ENABLE();
    tickWatchdog();
    if (qsServiceDue()) {
        qsTransmitSome();
        int avail = QP_ARDUINO_QS_SERIAL.available();
        if (avail > 0) {
            do {
                QS::rxPut(static_cast<std::uint8_t>(QP_ARDUINO_QS_SERIAL.read()));
            } while (--avail > 0);
            QS::rxParse();
        }
    }
    BSP::roleLow(BSP::ROLE_IDLE);
}
extern "C" Q_NORETURN Q_onError(char const * const module, int const id) {
    QS_ASSERTION(module, id, 0U); // record + bounded flush
    __asm volatile ("cpsid i" ::: "memory");
    digitalWrite(kRolePin, HIGH); // analyzer signature: 2 s high, then reset
    std::uint32_t const start = micros();
    while ((micros() - start) < 2000000U) {
    }
    watchdog_reboot(0U, 0U, 10U);
    for (;;) {
    }
}

//============================================================================
// QS callbacks
bool QP::QS::onStartup(void const *arg) {
    Q_UNUSED_PAR(arg);
    static std::uint8_t qsTxBuf[4096];
    static std::uint8_t qsRxBuf[256];
    initBuf(qsTxBuf, sizeof(qsTxBuf));
    rxInitBuf(qsRxBuf, sizeof(qsRxBuf));
    QP_ARDUINO_QS_SERIAL.begin(115200);

    QS_GLB_FILTER(QP::QS_SM_RECORDS);
    QS_GLB_FILTER(QP::QS_AO_RECORDS);
    QS_GLB_FILTER(QP::QS_EQ_RECORDS);
    QS_GLB_FILTER(QP::QS_MP_RECORDS);
    QS_GLB_FILTER(QP::QS_QF_RECORDS); // QF-New, QF-gc, QF-Tick
    QS_GLB_FILTER(QP::QS_TE_RECORDS);
    QS_GLB_FILTER(QP::QS_UA_RECORDS);
    return true;
}
void QP::QS::onCleanup() {
}
QP::QSTimeCtr QP::QS::onGetTime() {
    return static_cast<QSTimeCtr>(micros());
}
void QP::QS::onFlush() {
    qsFlushBounded(200000U);
}
void QP::QS::onReset() {
    watchdog_reboot(0U, 0U, 10U);
    for (;;) {
    }
}
void QP::QS::onCommand(std::uint8_t cmdId, std::uint32_t param1,
                       std::uint32_t param2, std::uint32_t param3)
{
    Q_UNUSED_PAR(param2);
    Q_UNUSED_PAR(param3);
    switch (cmdId) {
        case 1U: {
            static QEvt const validateEvt(VALIDATE_SIG);
            QActive::publish_(&validateEvt, &l_commandId, 0U);
            break;
        }
        case 2U: {
            ValidationEvt * const evt = Q_NEW(ValidationEvt, DYN_SIG);
            evt->seq = param1;
            AO_Validator->POST(evt, &l_commandId);
            break;
        }
        case 3U: {
            BSP::rolePulse(BSP::ROLE_MARKER);
            break;
        }
        case 4U: {
            Q_ERROR_ID(400);
            break;
        }
        case 5U: {
            BSP::setRole(static_cast<std::uint8_t>(param1));
            break;
        }
        case 6U: {
            Validator_report();
            break;
        }
        case 7U: {
            Validator_resetCounters();
            break;
        }
        default: {
            break;
        }
    }
}
